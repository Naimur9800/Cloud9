## drivers/input/ffingerprint/fingerprint/Kconfig
```kconfig
#
#Fingerprint
#
menu "Reallytek Fingerprint support"
	depends on MEDIATEK_SOLUTION

config RLK_FINGERPRINT_SUPPORT
	bool "Reallytek Fingerprint"
	default n
	---help---
	Fingerprint mtk driver enable/disable in the kernel.
	Say Y here if you want to use mediatek fingerprint driver,
	fingerprint driver will support fingerprint function in REE,
	it supports FPC's 102x/104x device.

if RLK_FINGERPRINT_SUPPORT

config RLK_FINGERPRINT_A121N
	bool "AFS121N fingerprint"
	default n
	---help---
	AFS Fingerprint chip
config GOODIX_FINGERPRINT_GF368M
	bool "Goodix GF368M Fingerprint"
	default n
	---help---
	Goodix Fingerprint chip /GF318/GF316M/GF318M TEE driver
endif
endmenu
```

## drivers/misc/mediatek/magnetometer/af9133/Kconfig
```kconfig
config MTK_AF9133
	bool "AFx133 for MediaTek package"
	default n
	help
	  It support different magnetometer sensor.
          If this option is set,
	  it will support
          AFx133 magnetometer.
```

## drivers/misc/mediatek/magnetometer/mmc3524x/Kconfig
```kconfig
config MTK_MMC3524X
	bool "AKM09911 for MediaTek package"
	default n
	help
	  It support different magnetometer sensor.
          If this option is set,
	  it will support
          MMC3524X magnetometer.
```
